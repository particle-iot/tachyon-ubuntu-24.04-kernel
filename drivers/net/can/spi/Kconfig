## drivers/net/can/spi/Kconfig
```kconfig
# SPDX-License-Identifier: GPL-2.0-only
menu "CAN SPI interfaces"
	depends on SPI

config CAN_HI311X
	tristate "Holt HI311x SPI CAN controllers"
	help
	  Driver for the Holt HI311x SPI CAN controllers.

config CAN_MCP251X
	tristate "Microchip MCP251x and MCP25625 SPI CAN controllers"
	help
	  Driver for the Microchip MCP251x and MCP25625 SPI CAN
	  controllers.

config CAN_MCP25XXFD
	tristate "Microchip MCP25xxFD SPI CAN controllers"
	depends on HAS_DMA
	help
	  The driver for the Microchip MCP25XXFD SPI FD-CAN
	  controller family.
	  Say yes here to build support for SPI to CAN devices
	  mcp25xxfd. To compile this driver as a module, choose
	  M here: the module will be called mcp25xxfd.

source "drivers/net/can/spi/mcp251xfd/Kconfig"

endmenu
```
