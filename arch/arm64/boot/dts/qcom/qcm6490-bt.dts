// SPDX-License-Identifier: BSD-3-Clause
/*
 * Copyright (c) 2023 Qualcomm Innovation Center, Inc. All rights reserved.
 */
/dts-v1/;
/plugin/;

#include <dt-bindings/clock/qcom,gcc-sc7280.h>
#include <dt-bindings/interconnect/qcom,sc7280.h>
#include <dt-bindings/interrupt-controller/arm-gic.h>
#include <dt-bindings/power/qcom-rpmpd.h>
#include "qcm6490-bt.dtsi"

/ {
       model = "Qualcomm Technologies, Inc. QCM6490 IDP";
       compatible = "qcom,qcm6490-idp", "qcom,qcm6490";

       /* This will be deprecated soon */
       qcom,msm-id = <497 0x10000>, <498 0x10000>, <475 0x10000>, <515 0x10000>;
       qcom,board-id = <34 0>, <34 1>;
};
