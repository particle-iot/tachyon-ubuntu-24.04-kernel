// SPDX-License-Identifier: BSD-3-Clause
/*
 * qcm6490-addons device tree source
 *
 * Copyright (c) 2023 Qualcomm Innovation Center, Inc. All rights reserved.
 *
 */

&soc {
	sram@146a5000{
		kaslr_offset@56d0 {
			compatible = "qcom,msm-imem-kaslr_offset";
			reg = <0x56d0 0xc>;
		};
	};
};
