// SPDX-License-Identifier: BSD-3-Clause
/*
 * Copyright (c) 2024 Qualcomm Innovation Center, Inc. All rights reserved.
 */

&soc {
	/* reserved */
};

&sram {
	mem_dump_table@10 {
		compatible = "qcom,msm-imem-mem-dump-table";
		reg = <0x10 0x8>;
	};

	kaslr_offset@6d0 {
		compatible = "qcom,msm-imem-kaslr_offset";
		reg = <0x6d0 0xc>;
	};
};
