// SPDX-License-Identifier: BSD-3-Clause
/*
 * Copyright (c) 2023 Qualcomm Innovation Center, Inc. All rights reserved.
 */
&soc{
	slim_msm: slim-ngd@3ac0000 {
		status = "okay";
		ngd@1 {
			reg = <1>;
			#address-cells = <1>;
			#size-cells = <1>;
			slimbus: btfmslim-driver {
				compatible = "slim217,221";
				reg = <1 0>;
				btfm_socname = "wcn6750";
			};
		};
	};
};
