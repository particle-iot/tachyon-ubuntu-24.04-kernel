/*
 * Copyright (c) Qualcomm Technologies, Inc. and/or its subsidiaries.
 */
// SPDX-License-Identifier: BSD-3-Clause

/dts-v1/;
/plugin/;

#include <dt-bindings/clock/qcom,qcs615-gcc.h>
#include <dt-bindings/clock/qcom,qcs615-gpucc.h>
#include <dt-bindings/interconnect/qcom,qcs615-rpmh.h>
#include <dt-bindings/interrupt-controller/arm-gic.h>
#include <dt-bindings/power/qcom-rpmpd.h>

#include "qcs615-graphics.dtsi"

/ {
	model = "Qualcomm Technologies, Inc. QCS615 Ride";
	compatible = "qcom,qcs615-addons-ride", "qcom,qcs615";
	qcom,msm-id = <377 0x0>, <380 0>, <384 0x0>, <680 0x0>;
	qcom,board-id = <0x03010019 0>, <0x03020019 0>, <0x10019 0>, <0x20019 0>;
};
