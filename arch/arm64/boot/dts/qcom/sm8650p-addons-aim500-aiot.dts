// SPDX-License-Identifier: BSD-3-Clause
/*
 * Copyright (c) 2024 Qualcomm Innovation Center, Inc. All rights reserved.
 */

/dts-v1/;

#include "sm8650p-aim500-aiot.dts"
#include "sm8650p-addons.dtsi"


/ {
	model = "Qualcomm Technologies, Inc. SM8650P-addons AIM500 AIOT";
	compatible = "qcom,sm8650p-addons-aim500-aiot", "qcom,sm8650p-aim500", "qcom,sm8650p",
		     "qcom,sm8650";
};

