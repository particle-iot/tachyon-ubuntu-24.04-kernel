// SPDX-License-Identifier: BSD-3-Clause
/*
 * qcs6490-addons RB3gen2 device tree source
 *
 * Copyright (c) 2024 Qualcomm Innovation Center, Inc. All rights reserved.
 *
 */

/dts-v1/;

#include "qcs6490-addons-rb3gen2.dts"

/ {
	model = "Qualcomm Technologies, Inc. Robotics RB3gen2 addons hsp platform";
	compatible = "qcom,qcs6490-addons-rb3gen2-hsp","qcom,qcm6490";

	qcom,msm-id = <497 0x10000>, <498 0x10000>, <475 0x10000>, <515 0x10000>;
	qcom,board-id = <32 0x6>, <32 0x606>;
};
