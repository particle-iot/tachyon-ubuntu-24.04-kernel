// SPDX-License-Identifier: BSD-3-Clause
/*
 * Copyright (c) 2024 Qualcomm Innovation Center, Inc. All rights reserved.
 */

&soc {
	wdog_gh: qcom,wdt_gh {
		compatible = "qcom,gh-watchdog";
		interrupts = <0 0 IRQ_TYPE_LEVEL_HIGH>;
	};
};
