// SPDX-License-Identifier: BSD-3-Clause
/*
 * Copyright (c) 2024 Qualcomm Innovation Center, Inc. All rights reserved.
 */

/dts-v1/;

#include "qcs8550-aim300-aiot.dts"
#include "qcm8550-addons.dtsi"


/ {
	model = "Qualcomm Technologies, Inc. QCS8550-addons AIM300 AIOT";
	compatible = "qcom,qcs8550-addons-aim300-aiot", "qcom,qcs8550-aim300", "qcom,qcs8550",
		     "qcom,qcm8550", "qcom,sm8550";
};
